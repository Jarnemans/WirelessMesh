

/ {
    leds {
        compatible = "gpio-leds";
        led0_green: led_0 {
			gpios = <&gpio0 6 GPIO_ACTIVE_LOW>;
			label = "Green LED 0";
		};
       
    };
    aliases {
        led0 = &led0_green;
        
    };
};
