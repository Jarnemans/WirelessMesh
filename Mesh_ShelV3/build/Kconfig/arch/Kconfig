## Mesh_ShelV3/build/Kconfig/arch/Kconfig
```kconfig
# Load arch Kconfig descriptions.
osource "C:/Users/toonk/zephyrproject/zephyr/arch/x86/Kconfig"
osource "C:/Users/toonk/zephyrproject/zephyr/arch/xtensa/Kconfig"
osource "C:/Users/toonk/zephyrproject/zephyr/arch/sparc/Kconfig"
osource "C:/Users/toonk/zephyrproject/zephyr/arch/riscv/Kconfig"
osource "C:/Users/toonk/zephyrproject/zephyr/arch/posix/Kconfig"
osource "C:/Users/toonk/zephyrproject/zephyr/arch/nios2/Kconfig"
osource "C:/Users/toonk/zephyrproject/zephyr/arch/mips/Kconfig"
osource "C:/Users/toonk/zephyrproject/zephyr/arch/arm64/Kconfig"
osource "C:/Users/toonk/zephyrproject/zephyr/arch/arm/Kconfig"
osource "C:/Users/toonk/zephyrproject/zephyr/arch/arc/Kconfig"
```
